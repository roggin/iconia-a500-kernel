## drivers/media/video/tegra/Kconfig
```kconfig
source "drivers/media/video/tegra/avp/Kconfig"
source "drivers/media/video/tegra/mediaserver/Kconfig"

config TEGRA_CAMERA
        bool "Enable support for tegra camera/isp hardware"
        depends on ARCH_TEGRA
        default y
        help
          Enables support for the Tegra camera interface

          If unsure, say Y

config VIDEO_OV5650
        tristate "OV5650 camera sensor support"
        depends on I2C && ARCH_TEGRA
        ---help---
          This is a driver for the Omnivision OV5650 5MP camera sensor
          for use with the tegra isp.

config VIDEO_OV2710
        tristate "OV2710 camera sensor support"
        depends on I2C && ARCH_TEGRA
        ---help---
          This is a driver for the Omnivision OV2710 camera sensor
          for use with the tegra isp.

config VIDEO_YUV
        tristate "YUV camera sensor support"
        depends on I2C && ARCH_TEGRA
        ---help---
          This is a template driver for all YUV camera sensor

config VIDEO_YUV5
	tristate "SOC5140 camera sensor support"
	depends on I2C && ARCH_TEGRA
	---help---
	  This is a driver for MT9P111 5M YUV camera sensor

config VIDEO_AD5820
        tristate "AD5820 focuser support"
        depends on I2C && ARCH_TEGRA
        ---help---
          This is a driver for AD5820 focuser

config VIDEO_LTC3216
        tristate "LTC3216 flash support"
        depends on I2C && ARCH_TEGRA
        ---help---
          This is a driver for AD5820 focuser
```
